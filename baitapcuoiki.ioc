# file: baitapcuoiki.ioc
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FREERTOS.Queues01=pipe_queue,16,float,0,Dynamic,NULL,NULL
FREERTOS.Tasks01=defaultTask,24,128,send_data_task,Default,NULL,Dynamic,NULL,NULL;myTask02,32,128,read_ss_temp_task,Default,NULL,Dynamic,NULL,NULL
Mcu.Family=STM32F4
Mcu.Name=STM32F411V(C-E)Tx
Mcu.Package=LQFP100
NVIC.PriorityGroup=NVIC_PRIORITYGROUP_4
PA13.Mode=Serial_Wire
PA13.Signal=SYS_JTMS-SWDIO
PA14.Mode=Serial_Wire
PA14.Signal=SYS_JTCK-SWCLK
ProjectManager.HeapSize=0x200
ProjectManager.StackSize=0x400
ProjectManager.TargetToolchain=STM32CubeIDE
RCC.AHBFreq_Value=16000000
RCC.APB1Freq_Value=16000000
RCC.APB2Freq_Value=16000000
RCC.CortexFreq_Value=16000000
RCC.HSE_VALUE=25000000
RCC.HSI_VALUE=16000000
RCC.LSE_VALUE=32768
RCC.SYSCLKFreq_VALUE=16000000
RCC.VCOOutputFreq_Value=192000000
VP_FREERTOS_VS_CMSIS_V2.Mode=CMSIS_V2
board=custom

// file: Core/Src/main.c
/* USER CODE BEGIN Header */
/**
  ******************************************************************************
  * @file           : main.c
  * @brief          : Main program body
  ******************************************************************************
  * @attention
  *
  * Copyright (c) 2023 STMicroelectronics.
  * All rights reserved.
  *
  * This software is licensed under terms that can be found in the LICENSE file
  * in the root directory of this software component.
  * If no LICENSE file comes with this software, it is provided AS-IS.
  *
  ******************************************************************************
  */
/* USER CODE END Header */
#include "main.h"
#include "cmsis_os.h"

/* USER CODE BEGIN Includes */
#include <string.h>
#include <stdio.h> 			// format data
/* USER CODE END Includes */

/* Definitions for defaultTask */
osThreadId_t defaultTaskHandle;
const osThreadAttr_t defaultTask_attributes = {
  .name = "defaultTask",
  .stack_size = 128 * 4,
  .priority = (osPriority_t) osPriorityNormal,
};
/* Definitions for myTask02 */
osThreadId_t myTask02Handle;
const osThreadAttr_t myTask02_attributes = {
  .name = "myTask02",
  .stack_size = 128 * 4,
  .priority = (osPriority_t) osPriorityAboveNormal,
};
/* Definitions for pipe_queue */
osMessageQueueId_t pipe_queueHandle;
const osMessageQueueAttr_t pipe_queue_attributes = {
  .name = "pipe_queue"
};
/* USER CODE BEGIN PV */
void ADC_Init()
{
	// set RCC gpio Pin A
	// set RCC cho ADC1
	__HAL_RCC_ADC1_CLK_ENABLE();
	uint32_t* CR2 = (uint32_t*)0x40012008;
	uint32_t* SMPR1 = (uint32_t*)0x4001200c;
	uint32_t* SMPR2 = (uint32_t*)0x40012010;
	uint32_t* JSQR = (uint32_t*)0x40012038;

	*SMPR1 |= (0b111 << 18);					// xác định hơn 15 cycles
	*SMPR2 |= (0b111 << 0);
	*JSQR &= ~(0b11 << 20); 					// 1 conversion
	*JSQR |= (16 << 15);						// xác định channal 16 vào JSQ4

	*CR2 |= (0b01 << 20) | (0b1 << 0);			// xác định bit 20 trigger Injected ADC
												//bit 0 enable ADC
	uint32_t* CCR = (uint32_t*)0x40012304;
	*CCR |= (0b1 << 23);
}

uint16_t Read_ADC()
{
	uint32_t* CR2 = (uint32_t*)0x40012008;
	uint32_t* SR = (uint32_t*)0x40012000;

	*CR2 |= (0b1 << 22);
	while(((*SR >> 2) & 1) == 0) {osDelay(1);};
	*SR &= ~(0b1 << 2);

	uint32_t* JDR1 = (uint32_t*)0x4001203c;
	return *JDR1;
}

void UART_Init()
{
	__HAL_RCC_GPIOA_CLK_ENABLE();
	__HAL_RCC_USART2_CLK_ENABLE();

	uint32_t* GPIOA_MODER = (uint32_t*)0x40020000;
	*GPIOA_MODER &= ~(0b1111 << 4); // set PIN2,3
	*GPIOA_MODER |= (0b10 << 4) | (0b10 << 6);// Pin2,3 Analog
	uint32_t* GPIOA_AFRL = (uint32_t*)0x40020020;
	*GPIOA_AFRL |= (7 << 8) | (7 << 12);

	// set baud rate 9600
	uint32_t* UART2_BRR = (uint32_t*)0x40004408;
	*UART2_BRR = (104 << 4) | 3;

	//set 13 enable UART, set 2 r/w enable TX, set 3 r/w enable RX
	// set 5 enable Interrupt of UART
	//size 8 byte and check chan le
	uint32_t* UART2_CR1 = (uint32_t*)0x4000440c;
	*UART2_CR1 |= (0b1 << 13) | (0b1 << 2) | (0b1 << 3);// | (0b1 << 5);

	//set enable DMA of UART
	uint32_t* UART2_CR3 = (uint32_t*)0x40004414;
	*UART2_CR3 |= (0b1 << 6);
}

void UART_Send_byte(char data)
{
	uint32_t* UART2_SR = (uint32_t*)0x40004400;
	uint32_t* UART2_DR = (uint32_t*)0x40004404;

	//set TXE if TXE set 1 to return;
	while(((*UART2_SR >> 7) & 1) != 1){osDelay(1);};
	*UART2_DR = data;
	// set TC if TC set 0 to return
	while(((*UART2_SR >> 6) & 1) != 0){osDelay(1);};
	//*UART2_SR &= ~(1 << 6);
}

void UART_Send_Arr(char* arr)
{
	int str_len = strlen(arr);
	for(int i = 0 ; i < str_len; i++)
	{
		UART_Send_byte(arr[i]);
	}
}
/* USER CODE END PV */

void SystemClock_Config(void);
static void MX_GPIO_Init(void);
void send_data_task(void *argument);
void read_ss_temp_task(void *argument);

int main(void)
{

  /* MCU Configuration--------------------------------------------------------*/

  /* Reset of all peripherals, Initializes the Flash interface and the Systick. */
  HAL_Init();

  /* Configure the system clock */
  SystemClock_Config();

  /* Initialize all configured peripherals */
  MX_GPIO_Init();

  /* Init scheduler */
  osKernelInitialize();

  /* Create the queue(s) */
  /* creation of pipe_queue */
  pipe_queueHandle = osMessageQueueNew (16, sizeof(float), &pipe_queue_attributes);

  /* Create the thread(s) */
  /* creation of defaultTask */
  defaultTaskHandle = osThreadNew(send_data_task, NULL, &defaultTask_attributes);

  /* creation of myTask02 */
  myTask02Handle = osThreadNew(read_ss_temp_task, NULL, &myTask02_attributes);

  /* Start scheduler */
  osKernelStart();

  /* We should never get here as control is now taken by the scheduler */
  /* Infinite loop */
  while (1)
  {

  }
}

void SystemClock_Config(void)
{
  RCC_OscInitTypeDef RCC_OscInitStruct = {0};
  RCC_ClkInitTypeDef RCC_ClkInitStruct = {0};

  /** Configure the main internal regulator output voltage
  */
  __HAL_RCC_PWR_CLK_ENABLE();
  __HAL_PWR_VOLTAGESCALING_CONFIG(PWR_REGULATOR_VOLTAGE_SCALE1);

  /** Initializes the RCC Oscillators according to the specified parameters
  * in the RCC_OscInitTypeDef structure.
  */
  RCC_OscInitStruct.OscillatorType = RCC_OSCILLATORTYPE_HSI;
  RCC_OscInitStruct.HSIState = RCC_HSI_ON;
  RCC_OscInitStruct.HSICalibrationValue = RCC_HSICALIBRATION_DEFAULT;
  RCC_OscInitStruct.PLL.PLLState = RCC_PLL_NONE;
  if (HAL_RCC_OscConfig(&RCC_OscInitStruct) != HAL_OK)
  {
    Error_Handler();
  }

  /** Initializes the CPU, AHB and APB buses clocks
  */
  RCC_ClkInitStruct.ClockType = RCC_CLOCKTYPE_HCLK|RCC_CLOCKTYPE_SYSCLK
                              |RCC_CLOCKTYPE_PCLK1|RCC_CLOCKTYPE_PCLK2;
  RCC_ClkInitStruct.SYSCLKSource = RCC_SYSCLKSOURCE_HSI;
  RCC_ClkInitStruct.AHBCLKDivider = RCC_SYSCLK_DIV1;
  RCC_ClkInitStruct.APB1CLKDivider = RCC_HCLK_DIV1;
  RCC_ClkInitStruct.APB2CLKDivider = RCC_HCLK_DIV1;

  if (HAL_RCC_ClockConfig(&RCC_ClkInitStruct, FLASH_LATENCY_0) != HAL_OK)
  {
    Error_Handler();
  }
}

static void MX_GPIO_Init(void)
{

  /* GPIO Ports Clock Enable */
  __HAL_RCC_GPIOA_CLK_ENABLE();

}

void send_data_task(void *argument)
{
  /* USER CODE BEGIN 5 */
	UART_Init();
	float temp = 0;
  /* Infinite loop */
	for(;;)
	{
		osMessageQueueGet(pipe_queueHandle, &temp, (void*)osPriorityNormal, 10000);
		char msg[32] = {0};
		char frac = (int)((temp - (int)temp) * 100);
		sprintf(msg, "temp: %d.%d *C\r\n", (int)temp, frac);
		UART_Send_Arr(msg);
		osDelay(1000);
	}
  /* USER CODE END 5 */
}

void read_ss_temp_task(void *argument)
{
  /* USER CODE BEGIN read_ss_temp_task */
	ADC_Init();
	uint16_t data_raw = 0;
	float vin = 0;
	float temp = 0;
  /* Infinite loop */
	for(;;)
	{
		data_raw = Read_ADC();
		vin = (data_raw * 3.0) / 4095.0;
		temp = ((vin - 0.76) / 0.0025) + 25;
		osMessageQueuePut(pipe_queueHandle, &temp, osPriorityNormal, 10000);
		//temp_global = temp;
		osDelay(1000);
	}
  /* USER CODE END read_ss_temp_task */
}

void Error_Handler(void)
{
  __disable_irq();
  while (1)
  {
  }
}
